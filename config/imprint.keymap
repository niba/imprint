#include <input/processors.dtsi>
#include <dt-bindings/zmk/input_transform.h>
#include <behaviors.dtsi>
#include <dt-bindings/zmk/bt.h>
#include <dt-bindings/zmk/keys.h>
#include <dt-bindings/zmk/pointing.h>
#include <dt-bindings/zmk/rgb.h>

#include "zmk-helpers/helper.h"
#include "imprint.h"

ZMK_APPLY_MATRIX_TRANSFORM(imprint_function_row)

#define KEYS_L \
    LC5 LC4 LC3 LC2 LC1 LC0 \
    LN5 LN4 LN3 LN2 LN1 LN0 \
    LT5 LT4 LT3 LT2 LT1 LT0 \
    LM5 LM4 LM3 LM2 LM1 LM0 \
    LB5 LB4 LB3 LB2 LB1 LB0 \
            LF1 LF0

#define KEYS_R \
    RC0 RC1 RC2 RC3 RC4 RC5 \
    RN0 RN1 RN2 RN3 RN4 RN5 \
    RT0 RT1 RT2 RT3 RT4 RT5 \
    RM0 RM1 RM2 RM3 RM4 RM5 \
    RB0 RB1 RB2 RB3 RB4 RB5 \
            RF0 RF1

#define THUMBS \
    LH2 LH1 LH0 \
    LHB2 LHB1 LHB0 \
    RH0 RH1 RH2 \
    RHB0 RHB1 RHB2

#include "base.keymap"

#ifndef ZMK_BASE_LAYER
  #define ZMK_BASE_LAYER(name, LC, RC, LN, RN, LT, RT, LM, RM, LB, RB, LF, RF, LH, RH, LHB, RHB)                 \
    ZMK_LAYER(name, LC RC LN RN LT RT LM RM LB RB LF RF LH RH LHB RHB)
#endif


ZMK_BASE_LAYER(Base,
//╭─────────────────┬─────────────────┬─────────────────┬─────────────────┬─────────────────┬─────────────────╮   ╭─────────────────┬─────────────────┬─────────────────┬─────────────────┬─────────────────┬─────────────────╮
    XXX               XXX               XXX               XXX               XXX               XXX              ,    XXX               XXX               XXX               XXX               XXX               XXX             ,
//├─────────────────┼─────────────────┼─────────────────┼─────────────────┼─────────────────┼─────────────────┤   ├─────────────────┼─────────────────┼─────────────────┼─────────────────┼─────────────────┼─────────────────┤
    &kp GRAVE         &kp N1            &kp N2            &kp N3            &kp N4            &kp N5           ,    &kp N6            &kp N7            &kp N8            &kp N9            &kp N0            &kp MINUS        ,
//├─────────────────┼─────────────────┼─────────────────┼─────────────────┼─────────────────┼─────────────────┤   ├─────────────────┼─────────────────┼─────────────────┼─────────────────┼─────────────────┼─────────────────┤
    &kp TAB           &kp Q             &kp W             &kp F             &kp P             &kp B            ,    &kp J             &kp L             &kp U             &kp Y             &kp SQT           &kp BSLH         ,
//├─────────────────┼─────────────────┼─────────────────┼─────────────────┼─────────────────┼─────────────────┤   ├─────────────────┼─────────────────┼─────────────────┼─────────────────┼─────────────────┼─────────────────┤
    &kp LBKT         &hml LALT A       &hml HYPER R      &hml LCTRL S       &hml LGUI T      &kp G             ,    &kp M             &hmr LGUI N       &hmr LCTRL E      &hmr HYPER I      &hmr LALT O       &kp RBKT         ,
//├─────────────────┼─────────────────┼─────────────────┼─────────────────┼─────────────────┼─────────────────┤   ├─────────────────┼─────────────────┼─────────────────┼─────────────────┼─────────────────┼─────────────────┤
    MAGIC_SHIFT      &kp Z             &kp X             &kp C             &kp D             &kp V             ,    &kp K             &kp H             &kp COMMA         &kp DOT           &kp FSLH          &kp RSHFT        ,
//├─────────────────┴─────────────────┴─────────────────┼─────────────────┼─────────────────├─────────────────┼   ├─────────────────┼─────────────────┼─────────────────┼─────────────────┴─────────────────┴─────────────────┤
                                        &swapper          &kp SQT                                              ,                                        &kp SQT           &kp RGUI          ,
//                                    ╰─────────────────┴─────────────────┼                                                                           ├─────────────────┼─────────────────╯
                                                          &lt SYMBOLS SPACE  &mt LSHIFT ESC  &kp RGUI          ,    &mkp LCLK          MAGIC_SHIFT      &lt NAV RET       ,
//                                                      ╰─────────────────┴─────────────────┼─────────────────┤   ├─────────────────┼─────────────────┼─────────────────╯
                                                          &kp BSPC          XXX              &kp RET           ,    &mo SYMBOLS         XXX             &mt RALT TAB
//                                                      ╰─────────────────┴─────────────────┴─────────────────╯   ╰─────────────────┴─────────────────┴─────────────────╯
)

ZMK_BASE_LAYER(Nav,
//╭─────────────────┬─────────────────┬─────────────────┬─────────────────┬─────────────────┬─────────────────╮   ╭─────────────────┬─────────────────┬─────────────────┬─────────────────┬─────────────────┬─────────────────╮
    ___               ___               ___               ___               ___               ___              ,    ___               ___               ___               ___               ___               ___             ,
//├─────────────────┼─────────────────┼─────────────────┼─────────────────┼─────────────────┼─────────────────┤   ├─────────────────┼─────────────────┼─────────────────┼─────────────────┼─────────────────┼─────────────────┤
    &kp F1           &kp F2            &kp F3            &kp F4            &kp F5            &kp F6            ,    &kp F7            &kp F8            &kp F9            &kp F10           &kp F11           &kp F12         ,
//├─────────────────┼─────────────────┼─────────────────┼─────────────────┼─────────────────┼─────────────────┤   ├─────────────────┼─────────────────┼─────────────────┼─────────────────┼─────────────────┼─────────────────┤
    ___              &kp PLUS          &kp N7            &kp N8            &kp N9            XXX               ,    XXX              &kp PG_UP          &prev_q           &next_q           XXX               ___             ,
//├─────────────────┼─────────────────┼─────────────────┼─────────────────┼─────────────────┼─────────────────┤   ├─────────────────┼─────────────────┼─────────────────┼─────────────────┼─────────────────┼─────────────────┤
    ___              &hml LALT MINUS   &hml HYPER N4      &hml LCTRL N5      &hml LGUI N6     &kp N0            ,  XXX               &kp LEFT          &kp DOWN          &kp UP            &kp RIGHT         ___             ,
//├─────────────────┼─────────────────┼─────────────────┼─────────────────┼─────────────────┼─────────────────┤   ├─────────────────┼─────────────────┼─────────────────┼─────────────────┼─────────────────┼─────────────────┤
    ___              ___               &kp N1            &kp N2            &kp N3            XXX               ,    XXX              &hmr LGUI PG_DN   &hmr LCTRL COMMA  &hmr HYPER DOT    &hmr LALT PG_UP          ___             ,
//├─────────────────┴─────────────────┴─────────────────┼─────────────────┼─────────────────├─────────────────┼   ├─────────────────┼─────────────────┼─────────────────┼─────────────────┴─────────────────┴─────────────────┤
                                        ___              ___                                                   ,                                        ___               ___              ,
//                                    ╰─────────────────┴─────────────────┼                                                                           ├─────────────────┼─────────────────╯
                                                          ___               ___               ___              ,      ___             ___               ___             ,
//                                                      ╰─────────────────┴─────────────────┼─────────────────┤   ├─────────────────┼─────────────────┼─────────────────╯
                                                          ___               ___               ___              ,      ___             ___               ___
//                                                      ╰─────────────────┴─────────────────┴─────────────────╯   ╰─────────────────┴─────────────────┴─────────────────╯
)

ZMK_BASE_LAYER(Symbols,
//╭─────────────────┬─────────────────┬─────────────────┬─────────────────┬─────────────────┬─────────────────╮   ╭─────────────────┬─────────────────┬─────────────────┬─────────────────┬─────────────────┬─────────────────╮
    ___               ___               ___               ___               ___               ___              ,    ___               ___               ___               ___               ___               ___             ,
//├─────────────────┼─────────────────┼─────────────────┼─────────────────┼─────────────────┼─────────────────┤   ├─────────────────┼─────────────────┼─────────────────┼─────────────────┼─────────────────┼─────────────────┤
    &kp F1           &kp F2            &kp F3            &kp F4            &kp F5            &kp F6            ,    &kp F7            &kp F8            &kp F9            &kp F10           &kp F11           &kp F12         ,
//├─────────────────┼─────────────────┼─────────────────┼─────────────────┼─────────────────┼─────────────────┤   ├─────────────────┼─────────────────┼─────────────────┼─────────────────┼─────────────────┼─────────────────┤
    ___              &kp CARET         &kp AT            &kp HASH          &kp DLLR          &kp PRCNT         ,    &kp PIPE          &kp AMPS          &kp ASTRK         &kp PLUS          XXX               ___             ,
//├─────────────────┼─────────────────┼─────────────────┼─────────────────┼─────────────────┼─────────────────┤   ├─────────────────┼─────────────────┼─────────────────┼─────────────────┼─────────────────┼─────────────────┤
    ___              &hml LALT MINUS   &hml HYPER COLON   &hml LCTRL DQT   &hml LGUI EQUAL  &kp UNDER          ,    &kp LBKT          &hmr LGUI LBRC    &hmr LCTRL LPAR   &hmr HYPER LT     &hmr LALT SEMI    ___             ,
//├─────────────────┼─────────────────┼─────────────────┼─────────────────┼─────────────────┼─────────────────┤   ├─────────────────┼─────────────────┼─────────────────┼─────────────────┼─────────────────┼─────────────────┤
    ___              &kp TILDE         &kp QMARK          &kp SQT          &kp EXCL          &kp GRAVE         ,    &kp RBKT          &kp RBRC          &kp RPAR          &kp GT            &kp BSLH          ___             ,
//├─────────────────┴─────────────────┴─────────────────┼─────────────────┼─────────────────├─────────────────┼   ├─────────────────┼─────────────────┼─────────────────┼─────────────────┴─────────────────┴─────────────────┤
                                        ___               ___                                                  ,                                        ___               ___              ,
//                                    ╰─────────────────┴─────────────────┼                                                                           ├─────────────────┼─────────────────╯
                                                          ___               ___               ___              ,      ___             ___               ___             ,
//                                                      ╰─────────────────┴─────────────────┼─────────────────┤   ├─────────────────┼─────────────────┼─────────────────╯
                                                          ___               ___               ___              ,      ___             ___               ___
//                                                      ╰─────────────────┴─────────────────┴─────────────────╯   ╰─────────────────┴─────────────────┴─────────────────╯
)

&trackball_peripheral_listener {
    input-processors = <&zip_xy_scaler 1 1>;

    scroller {
        layers = <SYMBOLS>;
        input-processors =      
            // disable horizontal scroll
            <&zip_x_scaler 1 1000000>,
            <&zip_y_scaler 1 10>,
            <&zip_xy_to_scroll_mapper>,
            <&zip_scroll_scaler 1 5>;
    };
};
