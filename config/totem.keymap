#include "totem.h"
#include <behaviors.dtsi>
#include <dt-bindings/zmk/bt.h>
#include <dt-bindings/zmk/keys.h>
#include "zmk-helpers/helper.h"

#define KEYS_L LT0 LT1 LT2 LT3 LT4 LM0 LM1 LM2 LM3 LM4 LB0 LB1 LB2 LB3 LB4 LB5  // left hand
#define KEYS_R RT0 RT1 RT2 RT3 RT4 RM0 RM1 RM2 RM3 RM4 RB0 RB1 RB2 RB3 RB4 RB5  // right hand
#define THUMBS LH2 LH1 LH0 RH0 RH1 RH2                                          // thumbs

#include "base.keymap"

#ifndef ZMK_BASE_LAYER
  #define ZMK_BASE_LAYER(name, LT, RT, LM, RM, LB, RB, LH, RH)                 \
    ZMK_LAYER(name, LT RT LM RM LB RB LH RH)
#endif



ZMK_BASE_LAYER(Base,
//╭─────────────────┬─────────────────┬─────────────────┬─────────────────┬─────────────────┬─────────────────╮   ╭─────────────────┬─────────────────┬─────────────────┬─────────────────┬─────────────────┬─────────────────╮
                      &kp Q             &kp W             &kp F             &kp P             &kp B            ,     &kp J             &kp L             &kp U             &kp Y             &kp SQT                            ,
//├─────────────────┼─────────────────┼─────────────────┼─────────────────┼─────────────────┼─────────────────┤   ├─────────────────┼─────────────────┼─────────────────┼─────────────────┼─────────────────┼─────────────────┤
                      &hml LALT A       &hml HYPER R      &hml LCTRL S       &hml LGUI T      &kp G             ,    &kp M             &hmr LGUI N       &hmr LCTRL E      &hmr HYPER I      &hmr LALT O                        ,
//├─────────────────┼─────────────────┼─────────────────┼─────────────────┼─────────────────┼─────────────────┤   ├─────────────────┼─────────────────┼─────────────────┼─────────────────┼─────────────────┼─────────────────┤
    MAGIC_SHIFT      &kp Z             &kp X             &kp C             &kp D             &kp V             ,    &kp K             &kp H             &kp COMMA         &kp DOT           &kp FSLH          &kp RBKT         ,
//├─────────────────┴─────────────────┴─────────────────┼─────────────────┼─────────────────├─────────────────┼   ├─────────────────┼─────────────────┼─────────────────┼─────────────────┴─────────────────┴─────────────────┤
                                                            &kp BSPC        &lt SYMBOLS SPACE  &mt LSHIFT ESC   ,    MAGIC_SHIFT       &lt NAV RET      &mt RALT TAB     
//                                                      ╰─────────────────┴─────────────────┴─────────────────╯   ╰─────────────────┴─────────────────┴─────────────────╯
)

ZMK_BASE_LAYER(Nav,
//╭─────────────────┬─────────────────┬─────────────────┬─────────────────┬─────────────────┬─────────────────╮   ╭─────────────────┬─────────────────┬─────────────────┬─────────────────┬─────────────────┬─────────────────╮
                     &kp PLUS          &kp N7            &kp N8            &kp N9            XXX               ,    XXX              &kp PG_UP          &prev_q           &next_q           XXX                                ,
//├─────────────────┼─────────────────┼─────────────────┼─────────────────┼─────────────────┼─────────────────┤   ├─────────────────┼─────────────────┼─────────────────┼─────────────────┼─────────────────┼─────────────────┤
                     &hml LALT MINUS   &hml HYPER N4     &hml LCTRL N5     &hml LGUI N6     &kp N0             ,    XXX               &kp LEFT          &kp DOWN          &kp UP            &kp RIGHT                          ,
//├─────────────────┼─────────────────┼─────────────────┼─────────────────┼─────────────────┼─────────────────┤   ├─────────────────┼─────────────────┼─────────────────┼─────────────────┼─────────────────┼─────────────────┤
    ___              ___               &kp N1            &kp N2            &kp N3            XXX               ,    XXX              &hmr LGUI PG_DN   &hmr LCTRL COMMA  &hmr HYPER DOT    &hmr LALT PG_UP          ___        ,
//├─────────────────┴─────────────────┴─────────────────┼─────────────────┼─────────────────├─────────────────┼   ├─────────────────┼─────────────────┼─────────────────┼─────────────────┴─────────────────┴─────────────────┤
                                                          ___               ___               ___              ,      ___             ___               ___             
//                                                      ╰─────────────────┴─────────────────┼─────────────────┤   ├─────────────────┼─────────────────┼─────────────────╯
)

ZMK_BASE_LAYER(Symbols,
//╭─────────────────┬─────────────────┬─────────────────┬─────────────────┬─────────────────┬─────────────────╮   ╭─────────────────┬─────────────────┬─────────────────┬─────────────────┬─────────────────┬─────────────────╮
                     &kp CARET         &kp AT            &kp HASH          &kp DLLR          &kp PRCNT         ,    &kp PIPE          &kp AMPS          &kp ASTRK         &kp PLUS          XXX                                ,
//├─────────────────┼─────────────────┼─────────────────┼─────────────────┼─────────────────┼─────────────────┤   ├─────────────────┼─────────────────┼─────────────────┼─────────────────┼─────────────────┼─────────────────┤
                     &hml LALT MINUS   &hml HYPER COLON   &hml LCTRL DQT   &hml LGUI EQUAL  &kp UNDER          ,    &kp LBKT          &hmr LGUI LBRC    &hmr LCTRL LPAR   &hmr HYPER LT     &hmr LALT SEMI                     ,
//├─────────────────┼─────────────────┼─────────────────┼─────────────────┼─────────────────┼─────────────────┤   ├─────────────────┼─────────────────┼─────────────────┼─────────────────┼─────────────────┼─────────────────┤
    ___              &kp TILDE         &kp QMARK          &kp SQT          &kp EXCL          &kp GRAVE         ,    &kp RBKT          &kp RBRC          &kp RPAR          &kp GT            &kp BSLH          ___              ,
//├─────────────────┴─────────────────┴─────────────────┼─────────────────┼─────────────────├─────────────────┼   ├─────────────────┼─────────────────┼─────────────────┼─────────────────┴─────────────────┴─────────────────┤
                                                          ___               ___               ___              ,      ___             ___               ___             
//                                                      ╰─────────────────┴─────────────────┼─────────────────┤   ├─────────────────┼─────────────────┼─────────────────╯
)
